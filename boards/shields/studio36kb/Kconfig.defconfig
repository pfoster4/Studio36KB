## boards/shields/studio36kb/Kconfig.defconfig
```kconfig
if SHIELD_STUDIO36KB_LEFT

# Name must be less than 16 characters long!
config ZMK_KEYBOARD_NAME
    default "Studio36KB"

config ZMK_SPLIT_ROLE_CENTRAL
    default y

config ZMK_SPLIT_BLE_CENTRAL_PERIPHERALS
  default 1

config BT_MAX_CONN
  default 6

config BT_MAX_PAIRED
  default 6

endif

if SHIELD_STUDIO36KB_LEFT || SHIELD_STUDIO36KB_RIGHT

config ZMK_SPLIT
    default y

endif

# ---------------------
# Kconfig for shield "studio36kb_left" with board "seeeduino_xiao_ble"
# ---------------------
if BOARD_SEEEDUINO_XIAO_BLE && SHIELD_STUDIO36KB_LEFT

config SPI
    default y

config WS2812_STRIP
    default y

endif

# ---------------------
# Kconfig for shield "studio36kb_right" with board "seeeduino_xiao_ble"
# ---------------------
if BOARD_SEEEDUINO_XIAO_BLE && SHIELD_STUDIO36KB_RIGHT

config SPI
    default y

config WS2812_STRIP
    default y

endif
```

## boards/shields/studio36kb/Kconfig.shield
```kconfig
config SHIELD_STUDIO36KB_LEFT
    def_bool $(shields_list_contains,studio36kb_left)
  
config SHIELD_STUDIO36KB_RIGHT
    def_bool $(shields_list_contains,studio36kb_right)
  
```
